## home_automation/actuators/LivoloLightsNode/zephyr_rtos/boards/arm/tt_nrf52/Kconfig.board
```kconfig
# Kconfig - Holyiot YJ-16019 board configuration
#
# Copyright (c) 2019 Henrik Brix Andersen <henrik@brixandersen.dk>
#
# SPDX-License-Identifier: Apache-2.0

config BOARD_TT_NRF52
	bool "TT NRF52"
	depends on SOC_NRF52832_QFAA
```

## home_automation/actuators/LivoloLightsNode/zephyr_rtos/zephyr/boards/arm/tt_nrf52/Kconfig.defconfig
```kconfig
# Kconfig - Holyiot YJ-16019 board configuration
#
# Copyright (c) 2019 Henrik Brix Andersen <henrik@brixandersen.dk>
#
# SPDX-License-Identifier: Apache-2.0

if BOARD_TT_NRF52

config BOARD
	default "tt_nrf52"

config BT_CTLR
  default BT

endif # BOARD_TT_NRF52
```

## sensors_network/project/LivoloLightsNode/mesh-onoff/boards/arm/arduino_bt/Kconfig.board
```kconfig
# Kconfig - Holyiot YJ-16019 board configuration
#
# Copyright (c) 2019 Henrik Brix Andersen <henrik@brixandersen.dk>
#
# SPDX-License-Identifier: Apache-2.0

config BOARD_ARDUINO_BT
	bool "Arduino BT"
	depends on SOC_NRF52832_QFAA
```

## sensors_network/project/LivoloLightsNode/zephyr/mesh-onoff/boards/arm/arduino_bt/arduino_bt_defconfig
```kconfig
CONFIG_ARM=y
CONFIG_SOC_FAMILY_NRF=y
CONFIG_SOC_SERIES_NRF52X=y
CONFIG_SOC_NRF52832_QFAA=y
CONFIG_BOARD_ARDUINO_BT=y

# Enable MPU
CONFIG_ARM_MPU=y

# Enable GPIO
CONFIG_GPIO=y

# enable uart driver
CONFIG_SERIAL=y

CONFIG_UART_NRFX=y
CONFIG_HAS_HW_NRF_UART0=y
CONFIG_HAS_HW_NRF_UARTE0=y
CONFIG_UART_0_NRF_UART=y
CONFIG_NRF_UART_PERIPHERAL=y

# enable console
CONFIG_CONSOLE=y
CONFIG_UART_CONSOLE=y
```

## sensors_network/project/LivoloLightsNode/zephyr/mesh-onoff/boards/arm/holyiot_17095/Kconfig
```kconfig
# Kconfig - Holyiot YJ-16019 board configuration
#
# Copyright (c) 2019 Henrik Brix Andersen <henrik@brixandersen.dk>
#
# SPDX-License-Identifier: Apache-2.0

config BOARD_ENABLE_DCDC
  bool "Enable DCDC mode"
    select SOC_DCDC_NRF52X
    default y
```

## sensors_network/project/LivoloLightsNode/zephyr/mesh-onoff/boards/arm/holyiot_17095/Kconfig.board
```kconfig
# Kconfig - Holyiot YJ-16019 board configuration
#
# Copyright (c) 2019 Henrik Brix Andersen <henrik@brixandersen.dk>
#
# SPDX-License-Identifier: Apache-2.0

config BOARD_HOLYIOT_17095
	bool "Holyiot 17095"
	depends on SOC_NRF52832_QFAA
```

## sensors_network/project/LivoloLightsNode/zephyr/mesh-onoff/boards/arm/holyiot_17095/Kconfig.defconfig
```kconfig
# Kconfig - Holyiot YJ-16019 board configuration
#
# Copyright (c) 2019 Henrik Brix Andersen <henrik@brixandersen.dk>
#
# SPDX-License-Identifier: Apache-2.0

if BOARD_HOLYIOT_17095

config BOARD
	default "holyiot_17095"

if PWM

config PWM_0
  default y

endif # PWM

config BT_CTLR
  default BT

endif # BOARD_HOLYIOT_17095
```

## sensors_network/project/LivoloLightsNode/zephyr/mesh-onoff/boards/arm/holyiot_17095/holyiot_17095_defconfig
```kconfig
CONFIG_ARM=y
CONFIG_SOC_SERIES_NRF52X=y
CONFIG_SOC_NRF52832_CIAA=y
CONFIG_BOARD_HOLYIOT_17095=y

# Enable MPU
CONFIG_ARM_MPU=y

# clock source
# holyiot_17095 module seems more stable if using the RC oscillator
CONFIG_CLOCK_CONTROL_NRF_K32SRC_RC=y

# enable GPIO
CONFIG_GPIO=y

# reset pin behavior
CONFIG_GPIO_AS_PINRESET=n

# bluetooth
CONFIG_BT=y
CONFIG_BT_CTLR=y
CONFIG_BT_CTLR_TX_PWR_PLUS_4=y

# enable PWM
CONFIG_PWM=y
```

## sensors_network/project/LivoloLightsNode/zephyr/mesh-onoff/boards/arm/ts_nrf52/Kconfig.board
```kconfig
# Kconfig - Holyiot YJ-16019 board configuration
#
# Copyright (c) 2019 Henrik Brix Andersen <henrik@brixandersen.dk>
#
# SPDX-License-Identifier: Apache-2.0

config BOARD_TS_NRF52
	bool "TS NRF52"
	depends on SOC_NRF52832_QFAA
```

## sensors_network/project/LivoloLightsNode/zephyr/mesh-onoff/boards/arm/ts_nrf52/Kconfig.defconfig
```kconfig
# Kconfig - Holyiot YJ-16019 board configuration
#
# Copyright (c) 2019 Henrik Brix Andersen <henrik@brixandersen.dk>
#
# SPDX-License-Identifier: Apache-2.0

if BOARD_TS_NRF52

config BOARD
	default "ts_nrf52"

config BT_CTLR
  default BT

endif # BOARD_TS_NRF52
```

## sensors_network/project/LivoloLightsNode/zephyr/mesh-onoff/boards/arm/ts_nrf52/ts_nrf52_defconfig
```kconfig
CONFIG_SOC_SERIES_NRF52X=y
CONFIG_SOC_NRF52832_QFAA=y
CONFIG_BOARD_TS_NRF52=y

# Enable MPU
CONFIG_ARM_MPU=y

# clock source
CONFIG_CLOCK_CONTROL_NRF_K32SRC_XTAL=y

# enable GPIO
CONFIG_GPIO=y

# reset pin behavior
CONFIG_GPIO_AS_PINRESET=n

# bluetooth
CONFIG_BT=y
CONFIG_BT_CTLR=y
CONFIG_BT_CTLR_TX_PWR_PLUS_4=y
```

## sensors_network/project/LivoloLightsNode/zephyr_rtos/zephyr/boards/arm/tt_nrf52/Kconfig
```kconfig
# Kconfig - Holyiot YJ-16019 board configuration
#
# Copyright (c) 2019 Henrik Brix Andersen <henrik@brixandersen.dk>
#
# SPDX-License-Identifier: Apache-2.0

config BOARD_ENABLE_DCDC
  bool "Enable DCDC mode"
  select SOC_DCDC_NRF52X
  default y
  depends on BOARD_TT_NRF52

config GPIO_AS_PINRESET
	bool "GPIO as pin reset (reset button)"
	default n
```
