## CMakeLists.txt
```
# SPDX-License-Identifier: Apache-2.0

cmake_minimum_required(VERSION 3.20.0)
set(BOARD_ROOT ${CMAKE_CURRENT_LIST_DIR})

set(BOARD tt_nrf52)

find_package(Zephyr REQUIRED HINTS $ENV{ZEPHYR_BASE})
project(mesh_light_switch)

target_sources(app PRIVATE
  ../src/main.c
	../src/mesh_logic.c
  ../src/ts_buttons_logic.c
  ../src/relays_logic.c
  ../src/leds_logic.c
)

target_include_directories(app PRIVATE include)
```

## prj.conf
```kconfig
# Bootloader configuration
CONFIG_BOOTLOADER_MCUBOOT=y
CONFIG_MCUMGR=y
CONFIG_MCUMGR_CMD_IMG_MGMT=y
CONFIG_MCUMGR_CMD_OS_MGMT=y

# General configuration
# CONFIG_MAIN_STACK_SIZE=4096
CONFIG_SYSTEM_WORKQUEUE_STACK_SIZE=2048
CONFIG_FLASH=y
CONFIG_FLASH_MAP=y
CONFIG_NVS=y
CONFIG_SETTINGS=y

# Bluetooth configuration
CONFIG_BT=y
CONFIG_BT_CTLR_TX_PWR_PLUS_4=y
CONFIG_BT_DEVICE_NAME="MLS"
CONFIG_BT_L2CAP_TX_BUF_COUNT=32
CONFIG_BT_OBSERVER=y
CONFIG_BT_PERIPHERAL=y
CONFIG_BT_SETTINGS=y
CONFIG_MCUMGR_SMP_BT=y
CONFIG_MCUMGR_SMP_BT_AUTHEN=n

# Disable unused Bluetooth features
CONFIG_BT_CTLR_DUP_FILTER_LEN=0
CONFIG_BT_CTLR_LE_ENC=n
# CONFIG_BT_DATA_LEN_UPDATE=n
CONFIG_BT_PHY_UPDATE=n
CONFIG_BT_CTLR_CHAN_SEL_2=n
CONFIG_BT_CTLR_MIN_USED_CHAN=n
CONFIG_BT_CTLR_PRIVACY=n

# Bluetooth mesh configuration
CONFIG_BT_MESH=y
CONFIG_BT_MESH_RELAY=y
CONFIG_BT_MESH_FRIEND=y
CONFIG_BT_MESH_ADV_BUF_COUNT=64
CONFIG_BT_MESH_TX_SEG_MAX=32
CONFIG_BT_MESH_PB_GATT=y
CONFIG_BT_MESH_GATT_PROXY=y

# Bluetooth mesh models
#CONFIG_BT_MESH_ONOFF_CLI=y

CONFIG_BT_MESH_SUBNET_COUNT=2
CONFIG_BT_MESH_APP_KEY_COUNT=2
CONFIG_BT_MESH_MODEL_KEY_COUNT=2
CONFIG_BT_MESH_MODEL_GROUP_COUNT=2

# Allow for large Bluetooth data packets.
CONFIG_BT_BUF_ACL_RX_SIZE=248
CONFIG_BT_L2CAP_TX_MTU=248
```

## src/main.c
```c
#ifdef CONFIG_MCUMGR_CMD_IMG_MGMT
#include "img_mgmt/img_mgmt.h"
#endif
#ifdef CONFIG_MCUMGR_CMD_OS_MGMT
#include "os_mgmt/os_mgmt.h"
#endif
#ifdef CONFIG_MCUMGR_SMP_BT
#include <zephyr/mgmt/mcumgr/smp_bt.h>
#endif
#include <zephyr/bluetooth/bluetooth.h>

#include "leds_logic.h"
#include "mesh_logic.h"
#include "relays_logic.h"
#include "ts_buttons_logic.h"


void main(void) {
  init_leds();
  init_relays();
  init_ts();

  // Initialize the Bluetooth Subsystem
  bt_enable(bt_ready);

#ifdef CONFIG_MCUMGR_CMD_OS_MGMT
  os_mgmt_register_group();
#endif

#ifdef CONFIG_MCUMGR_CMD_IMG_MGMT
  img_mgmt_register_group();
#endif

#ifdef CONFIG_MCUMGR_SMP_BT
  smp_bt_register();
#endif
}
```

## include/leds_logic.h
```c
#ifndef LEDS_LOGIC_H
#define LEDS_LOGIC_H

#include <stdint.h>


void init_leds(void);
void set_led_state(uint8_t channel, uint8_t state);

#endif
```

## include/mesh_logic.h
```c
#ifndef MESH_LOGIC_H
#define MESH_LOGIC_H

#include <stdint.h>


void bt_ready(int err);
void mesh_publish_state(uint8_t channel, uint8_t new_state);

#endif
```

## include/node_conf.h
```c
#ifndef NODE_CONF_H
#define NODE_CONF_H

#define NRF52_TT_BOARD_TYPE

#define LIGHT_CHANNELS 1
#define LIGHT_CHANNEL_1_INDEX 0
#define LIGHT_CHANNEL_2_INDEX 1
//#define VSENSE_FEATURE


#if defined(NRF52_TT_BOARD_TYPE)
  #if LIGHT_CHANNELS == 1
    #define S1_LED_PIN 17
    #define TS1_PIN 12
    #ifdef VSENSE_FEATURE
      #define VSENSE_PIN 18
    #endif
    #define RELAY1_SET_PIN 14
    #define RELAY1_RESET_PIN 13
  #elif LIGHT_CHANNELS == 2
    #define S1_LED_PIN 20
    #define S2_LED_PIN 11
    #define TS1_PIN 19
    #define TS2_PIN 17
    #ifdef VSENSE_FEATURE
      #define VSENSE_PIN 22
    #endif
    #define RELAY1_SET_PIN 13
    #define RELAY1_RESET_PIN 12
    #define RELAY2_SET_PIN 15
    #define RELAY2_RESET_PIN 14
  #else
    #error "Unsupported number of channels!"
  #endif
#else
  #error "Unknown board type!"
#endif

#endif
```

## include/relays_logic.h
```c
#ifndef RELAYS_LOGIC_H
#define RELAYS_LOGIC_H

#include <stdint.h>


void relay_toggle(uint8_t channel);
void set_relay_state(uint8_t channel, uint8_t new_state);
uint8_t get_relay_state(uint8_t channel);
void init_relays(void);

#endif
```

## src/leds_logic.c
```c
#include <zephyr/device.h>
#include <zephyr/drivers/gpio.h>

#include "leds_logic.h"
#include "node_conf.h"


#define LOW 0
#define HIGH 1

static uint8_t LED_PINS[LIGHT_CHANNELS] = {
  S1_LED_PIN,
#if LIGHT_CHANNELS == 2
  S2_LED_PIN
#endif
};

static const struct device *gpio_dev_port;


void set_led_state(uint8_t channel, uint8_t state) {
  gpio_pin_set(gpio_dev_port, LED_PINS[channel], !state);
}

void init_leds(void) {
  gpio_dev_port = device_get_binding("GPIO_0");

  gpio_pin_configure(gpio_dev_port, S1_LED_PIN, GPIO_OUTPUT);
  gpio_pin_set(gpio_dev_port, S1_LED_PIN, HIGH);

#if LIGHT_CHANNELS == 2
  gpio_pin_configure(gpio_dev_port, S2_LED_PIN, GPIO_OUTPUT);
  gpio_pin_set(gpio_dev_port, S2_LED_PIN, HIGH);
#endif
}
```

## src/mesh_logic.c
```c
#include <stdint.h>
#include <zephyr/bluetooth/bluetooth.h>
#include <zephyr/bluetooth/mesh.h>

#include "mesh_logic.h"
#include "relays_logic.h"
#include "node_conf.h"


#define BT_MESH_MODEL_OP_GEN_ONOFF_GET        BT_MESH_MODEL_OP_2(0x82, 0x01)
#define BT_MESH_MODEL_OP_GEN_ONOFF_SET        BT_MESH_MODEL_OP_2(0x82, 0x02)
#define BT_MESH_MODEL_OP_GEN_ONOFF_SET_UNACK  BT_MESH_MODEL_OP_2(0x82, 0x03)
#define BT_MESH_MODEL_OP_GEN_ONOFF_STATUS     BT_MESH_MODEL_OP_2(0x82, 0x04)


static int gen_onoff_set(struct bt_mesh_model *model, struct bt_mesh_msg_ctx *ctx, struct net_buf_simple *buf);
static int gen_onoff_set_unack(struct bt_mesh_model *model, struct bt_mesh_msg_ctx *ctx, struct net_buf_simple *buf);
static int gen_onoff_get(struct bt_mesh_model *model, struct bt_mesh_msg_ctx *ctx, struct net_buf_simple *buf);
static int gen_onoff_status(struct bt_mesh_model *model, struct bt_mesh_msg_ctx *ctx, struct net_buf_simple *buf);


static struct bt_mesh_health_srv health_srv = {};

BT_MESH_HEALTH_PUB_DEFINE(health_pub, 0);

BT_MESH_MODEL_PUB_DEFINE(gen_onoff_pub_srv_ch1, NULL, 2 + 1);
BT_MESH_MODEL_PUB_DEFINE(gen_onoff_pub_cli_ch1, NULL, 2 + 1);

#if LIGHT_CHANNELS == 2
BT_MESH_MODEL_PUB_DEFINE(gen_onoff_pub_srv_ch2, NULL, 2 + 1);
BT_MESH_MODEL_PUB_DEFINE(gen_onoff_pub_cli_ch2, NULL, 2 + 1);
#endif


static const struct bt_mesh_model_op gen_onoff_srv_op[] = {
  { BT_MESH_MODEL_OP_GEN_ONOFF_GET, 0, gen_onoff_get },
  { BT_MESH_MODEL_OP_GEN_ONOFF_SET, 1, gen_onoff_set },
  { BT_MESH_MODEL_OP_GEN_ONOFF_SET_UNACK, 1, gen_onoff_set_unack },
  BT_MESH_MODEL_OP_END
};


static const struct bt_mesh_model_op gen_onoff_cli_op[] = {
  { BT_MESH_MODEL_OP_GEN_ONOFF_STATUS, BT_MESH_LEN_EXACT(1), gen_onoff_status },
  BT_MESH_MODEL_OP_END
};


static uint8_t light_channel_idx[] = {
  0,
#if LIGHT_CHANNELS == 2
  1
#endif
};

static struct bt_mesh_model root_models[] = {
  BT_MESH_MODEL_CFG_SRV,
  BT_MESH_MODEL_HEALTH_SRV(&health_srv, &health_pub)
};

static struct bt_mesh_model secondary_models_ch1[] = {
  BT_MESH_MODEL(BT_MESH_MODEL_ID_GEN_ONOFF_SRV, gen_onoff_srv_op, &gen_onoff_pub_srv_ch1, &light_channel_idx[0]),
  BT_MESH_MODEL(BT_MESH_MODEL_ID_GEN_ONOFF_CLI, gen_onoff_cli_op, &gen_onoff_pub_cli_ch1, &light_channel_idx[0])
};

#if LIGHT_CHANNELS == 2
static struct bt_mesh_model secondary_models_ch2[] = {
  BT_MESH_MODEL(BT_MESH_MODEL_ID_GEN_ONOFF_SRV, gen_onoff_srv_op, &gen_onoff_pub_srv_ch2, &light_channel_idx[1]),
  BT_MESH_MODEL(BT_MESH_MODEL_ID_GEN_ONOFF_CLI, gen_onoff_cli_op, &gen_onoff_pub_cli_ch2, &light_channel_idx[1])
};
#endif


static struct bt_mesh_model *mod_cli_ts_btn[] = {
  &secondary_models_ch1[1],
#if LIGHT_CHANNELS == 2
  &secondary_models_ch2[1],
#endif
};


static struct bt_mesh_elem elements[] = {
  BT_MESH_ELEM(0, root_models, BT_MESH_MODEL_NONE),
  BT_MESH_ELEM(0, secondary_models_ch1, BT_MESH_MODEL_NONE),
#if LIGHT_CHANNELS == 2
  BT_MESH_ELEM(0, secondary_models_ch2, BT_MESH_MODEL_NONE),
#endif
};

static const struct bt_mesh_comp comp = {
  .cid = BT_COMP_ID_LF,
  .elem = elements,
  .elem_count = ARRAY_SIZE(elements)
};

static uint16_t primary_addr;
static uint16_t primary_net_idx;


static int gen_onoff_get(struct bt_mesh_model *model, struct bt_mesh_msg_ctx *ctx, struct net_buf_simple *buf) {
  NET_BUF_SIMPLE_DEFINE(msg, 2 + 1 + 4);

  uint8_t *channel = (uint8_t*)model->user_data;

  bt_mesh_model_msg_init(&msg, BT_MESH_MODEL_OP_GEN_ONOFF_STATUS);
  net_buf_simple_add_u8(&msg, get_relay_state(*channel));

  bt_mesh_model_send(model, ctx, &msg, NULL, NULL);

  return 0;
}

static int gen_onoff_set_unack(struct bt_mesh_model *model, struct bt_mesh_msg_ctx *ctx, struct net_buf_simple *buf) {
  struct net_buf_simple *msg = model->pub->msg;
  uint8_t *channel = (uint8_t *)model->user_data;
  uint8_t desired_state = net_buf_simple_pull_u8(buf);
  uint8_t current_state = get_relay_state(*channel);

  if (desired_state != current_state) {
    set_relay_state(*channel, desired_state);
  }

  if (model->pub->addr != BT_MESH_ADDR_UNASSIGNED) {
    bt_mesh_model_msg_init(msg, BT_MESH_MODEL_OP_GEN_ONOFF_STATUS);
    net_buf_simple_add_u8(msg, get_relay_state(*channel));
    bt_mesh_model_publish(model);
  }

  return 0;
}

static int gen_onoff_set(struct bt_mesh_model *model, struct bt_mesh_msg_ctx *ctx, struct net_buf_simple *buf) {
  gen_onoff_set_unack(model, ctx, buf);
  gen_onoff_get(model, ctx, buf);

  return 0;
}

static int gen_onoff_status(struct bt_mesh_model *model, struct bt_mesh_msg_ctx *ctx, struct net_buf_simple *buf) {
  return 0;
}

static void prov_complete(uint16_t net_idx, uint16_t addr) {
  primary_addr = addr;
  primary_net_idx = net_idx;
}

static void prov_reset(void) {
  bt_mesh_prov_enable(BT_MESH_PROV_ADV | BT_MESH_PROV_GATT);
}

static uint8_t dev_uuid[16] = {0xdd, 0xdd};


static const struct bt_mesh_prov prov = {
  .uuid = dev_uuid,
  .output_size = 0,
  .output_actions = 0,
  .output_number = 0,
  .complete = prov_complete,
  .reset = prov_reset
};


void bt_ready(int err) {
  struct bt_le_oob oob;

  if (err) {
    // Bluetooth init failed
    return;
  }

  err = bt_mesh_init(&prov, &comp);
  if (err) {
    // Initializing mesh failed
    return;
  }

  if (IS_ENABLED(CONFIG_SETTINGS)) {
    settings_load();
  }

  /* Use identity address as device UUID */
  if (bt_le_oob_get_local(BT_ID_DEFAULT, &oob)) {
    // Identity Address unavailable
  } else {
    memcpy(dev_uuid, oob.addr.a.val, 6);
  }

  bt_mesh_prov_enable(BT_MESH_PROV_ADV | BT_MESH_PROV_GATT);
}

void mesh_publish_state(uint8_t channel, uint8_t new_state) {
  struct bt_mesh_model *mod_cli = mod_cli_ts_btn[channel];
  struct bt_mesh_model_pub *pub_cli = mod_cli->pub;

  if (pub_cli->addr == BT_MESH_ADDR_UNASSIGNED) {
    return;
  }

  bt_mesh_model_msg_init(pub_cli->msg, BT_MESH_MODEL_OP_GEN_ONOFF_SET);
  net_buf_simple_add_u8(pub_cli->msg, new_state);

  bt_mesh_model_publish(mod_cli);
}
```

## src/relays_logic.c
```c
#include <stdint.h>
#include <zephyr/device.h>
#include <zephyr/drivers/gpio.h>

#include "relays_logic.h"
#include "leds_logic.h"
#include "mesh_logic.h"
#include "node_conf.h"


#define OFF 0
#define ON  1

#define LOW  0
#define HIGH 1

#define RELAY1_INIT_TIMEOUT_MS 1500
#if LIGHT_CHANNELS == 2
#define RELAY2_INIT_TIMEOUT_MS 2500
#endif
#define RELAY_TRIGGER_PULSE_DURATION_MS 40

static const struct device *gpio_dev_port;
static uint8_t coil_pin;
static uint8_t ch_state[LIGHT_CHANNELS];

static uint8_t RELAY_COIL[][2] = {
  { RELAY1_RESET_PIN, RELAY1_SET_PIN },
#if LIGHT_CHANNELS == 2
  { RELAY2_RESET_PIN, RELAY2_SET_PIN }
#endif
};


static void relay_pulse_timeout(struct k_timer *tim);
K_TIMER_DEFINE(relay_pulse_timer, relay_pulse_timeout, NULL);

static void relay1_init_timeout_handler(struct k_timer *tim);
K_TIMER_DEFINE(relay1_init_timer, relay1_init_timeout_handler, NULL);
#if LIGHT_CHANNELS == 2
static void relay2_init_timeout_handler(struct k_timer *tim);
K_TIMER_DEFINE(relay2_init_timer, relay2_init_timeout_handler, NULL);
#endif

static void relay_pulse_timeout(struct k_timer *tim) {
  gpio_pin_set(gpio_dev_port, coil_pin, LOW);
}

uint8_t get_relay_state(uint8_t channel) {
  return ch_state[channel];
}

void set_relay_state(uint8_t channel, uint8_t new_state) {
  ch_state[channel] = new_state;
  coil_pin = RELAY_COIL[channel][new_state];

  gpio_pin_set(gpio_dev_port, coil_pin, HIGH);
  k_timer_start(&relay_pulse_timer, K_MSEC(RELAY_TRIGGER_PULSE_DURATION_MS), K_NO_WAIT);
  set_led_state(channel, new_state);
  mesh_publish_state(channel, ch_state[channel]);
}

void relay_toggle(uint8_t channel) {
  ch_state[channel] = !ch_state[channel];

  set_relay_state(channel, ch_state[channel]);
}

static void relay1_init_timeout_handler(struct k_timer *tim) {
  set_relay_state(LIGHT_CHANNEL_1_INDEX, OFF);
}

#if LIGHT_CHANNELS == 2
static void relay2_init_timeout_handler(struct k_timer *tim) {
  set_relay_state(LIGHT_CHANNEL_2_INDEX, OFF);
}
#endif

void init_relays(void) {
  gpio_dev_port = device_get_binding("GPIO_0");

  // Channel 1 relay coils
  gpio_pin_configure(gpio_dev_port, RELAY1_SET_PIN, GPIO_OUTPUT);
  gpio_pin_configure(gpio_dev_port, RELAY1_RESET_PIN, GPIO_OUTPUT);
  gpio_pin_set(gpio_dev_port, RELAY1_SET_PIN, LOW);
  gpio_pin_set(gpio_dev_port, RELAY1_RESET_PIN, LOW);

#if LIGHT_CHANNELS == 2
  // Channel 2 relay coils
  gpio_pin_configure(gpio_dev_port, RELAY2_SET_PIN, GPIO_OUTPUT);
  gpio_pin_configure(gpio_dev_port, RELAY2_RESET_PIN, GPIO_OUTPUT);
  gpio_pin_set(gpio_dev_port, RELAY2_SET_PIN, LOW);
  gpio_pin_set(gpio_dev_port, RELAY2_RESET_PIN, LOW);
#endif

  // reset relays to the OFF state after some time when the system starts
  // when having multiple relays make sure that they are NOT reset at the same time
  k_timer_start(&relay1_init_timer, K_MSEC(RELAY1_INIT_TIMEOUT_MS), K_NO_WAIT);
#if LIGHT_CHANNELS == 2
  k_timer_start(&relay2_init_timer, K_MSEC(RELAY2_INIT_TIMEOUT_MS), K_NO_WAIT);
#endif
}
```

## src/ts_buttons_logic.c
```c
#include <stdint.h>
#include <zephyr/bluetooth/mesh.h>
#include <zephyr/device.h>
#include <zephyr/drivers/gpio.h>
#include <zephyr/kernel.h>

#include "node_conf.h"
#include "relays_logic.h"
#include "ts_buttons_logic.h"


#define LOW  0
#define HIGH 1

#define BUTTON_SHORT_PRESS_INTERVAL_MS  500
#define BUTTON_LONG_PRESS_INTERVAL_MS  5000
#define MESH_RESET_TIMEOUT_MS          1000

static struct k_work_delayable mr_work;
static const struct device *gpio_dev_port;
static struct gpio_callback ts_cb;


static void mesh_reset_handler(struct k_work *item) {
  bt_mesh_reset();
}

static void process_button(uint8_t pin, uint8_t channel) {
  static uint64_t last_press_timestamp;

  if ((gpio_pin_get(gpio_dev_port, pin) == LOW) &&
        (k_uptime_get() - last_press_timestamp) >= BUTTON_SHORT_PRESS_INTERVAL_MS) {
    relay_toggle(channel);
    last_press_timestamp = k_uptime_get();
  }

  if ((gpio_pin_get(gpio_dev_port, pin) == HIGH) &&
        (k_uptime_get() - last_press_timestamp) >= BUTTON_LONG_PRESS_INTERVAL_MS) {
    k_work_schedule(&mr_work, K_MSEC(MESH_RESET_TIMEOUT_MS));
  }
}

static void button_pressed_handler(const struct device *dev, struct gpio_callback *cb, uint32_t pins) {
  // process TS1
  if (pins & BIT(TS1_PIN)) {
    process_button(TS1_PIN, LIGHT_CHANNEL_1_INDEX);
  }
#if LIGHT_CHANNELS == 2
  // process TS2
  if (pins & BIT(TS2_PIN)) {
    process_button(TS2_PIN, LIGHT_CHANNEL_2_INDEX);
  }
#endif
}

void init_ts(void) {
  k_work_init_delayable(&mr_work, mesh_reset_handler);

  gpio_dev_port = device_get_binding("GPIO_0");

  // Touch sensor reading
  gpio_pin_configure(gpio_dev_port, TS1_PIN, GPIO_INPUT);
  gpio_pin_interrupt_configure(gpio_dev_port, TS1_PIN, GPIO_INT_EDGE_BOTH);
#if LIGHT_CHANNELS == 2
  gpio_pin_configure(gpio_dev_port, TS2_PIN, GPIO_INPUT);
  gpio_pin_interrupt_configure(gpio_dev_port, TS2_PIN, GPIO_INT_EDGE_BOTH);
#endif
  gpio_init_callback(&ts_cb, button_pressed_handler, BIT(TS1_PIN)
#if LIGHT_CHANNELS == 2
    | BIT(TS2_PIN)
#endif
  );
  gpio_add_callback(gpio_dev_port, &ts_cb);
}
```
